## CMakeLists.txt
```
cmake_minimum_required(VERSION 3.20.0)
find_package(Zephyr REQUIRED HINTS $ENV{ZEPHYR_BASE})
project(gnss_master_thesis)

FILE(GLOB root src/*.c)
FILE(GLOB toolkits src/toolkits/*.c)
FILE(GLOB app src/app/*.c)

target_sources(app PRIVATE
  ${root}
  ${toolkits}
  ${app}
)

# App inc
zephyr_library_include_directories(.)
zephyr_library_include_directories(./src)
zephyr_library_include_directories(./src/toolkits)
zephyr_library_include_directories(./src/app)
```

## prj.conf
```kconfig
#
# Copyright (c) 2019 Nordic Semiconductor ASA
#
# SPDX-License-Identifier: LicenseRef-Nordic-5-Clause
#

# General
CONFIG_FPU=y
CONFIG_NRF_MODEM_LIB=y
CONFIG_UART_INTERRUPT_DRIVEN=y
CONFIG_PICOLIBC_IO_FLOAT=y
CONFIG_LOG=y
CONFIG_LOG_MODE_IMMEDIATE=y

# GNSS sample
# Enable to use nRF Cloud A-GNSS
CONFIG_NRF_CLOUD_AGNSS=y
CONFIG_NRF_CLOUD_REST=y
# LTE Link Control
CONFIG_LTE_LINK_CONTROL=y
# Request eDRX from the network
CONFIG_LTE_EDRX_REQ=y
# PSM requested periodic TAU 8 hours
CONFIG_LTE_PSM_REQ_RPTAU="00101000"
# PSM requested active time 6 seconds
CONFIG_LTE_PSM_REQ_RAT="00000011"

# AT Host library - Used to send AT commands directy from an UART terminal and to allow
#		    integration with nRF Connect for Desktop LTE Link monitor application.
CONFIG_AT_HOST_LIBRARY=y

# Networking
CONFIG_NETWORKING=y
CONFIG_NET_SOCKETS_OFFLOAD=y
CONFIG_NET_SOCKETS=y
CONFIG_POSIX_API=y
# Disable native network stack to save some memory
CONFIG_NET_NATIVE=n

# Memory and stack configuration
CONFIG_HEAP_MEM_POOL_SIZE=2048
CONFIG_MAIN_STACK_SIZE=4096
CONFIG_SYSTEM_WORKQUEUE_STACK_SIZE=1536
CONFIG_LOG=y
CONFIG_LOG_BACKEND_RTT=y
CONFIG_USE_SEGGER_RTT=y
CONFIG_LOG_PRINTK=y
CONFIG_NRFX_RTC0=y
CONFIG_CONSOLE=y
CONFIG_UART_CONSOLE=n

CONFIG_PM=y
CONFIG_PM_DEVICE=y

CONFIG_SERIAL=y
CONFIG_UART_0_INTERRUPT_DRIVEN=y
```

## rtc.overlay
```dts
/ {
    aliases {
        rtc0 = &rtc0;
    };
};

&rtc0 {
    status="okay";
};

/ {
    chosen {
             /delete-property/ zephyr,shell-uart;
             /delete-property/ zephyr,uart-mcumgr;
             /delete-property/ zephyr,bt-mon-uart;
    };
};
```

## src/main.c
```c
/* ============================================================================================== */
/*                                            INCLUDES                                            */
#include <zephyr/kernel.h>
#include <zephyr/logging/log.h>
#include <modem/lte_lc.h>
#include <nrfx_rtc.h>
#include <hal/nrf_rtc.h>
#include <nrf_modem_at.h>
#include <nrf_modem_gnss.h>

#include "rtc_api.h"
#include "app_uart.h"

/* ============================================================================================== */

/* ============================================================================================== */
/*                                        DEFINES/TYPEDEFS                                        */
#define GNSS_TIMEOUT                        K_SECONDS(120)
#define RTC_SECONDS(s)                      (s * 8)
/* ============================================================================================== */
/*                                   PRIVATE FUNCTION DEFINITIONS                                 */

static void print_gnss_data(const struct nrf_modem_gnss_pvt_data_frame *pvt);
static void gnss_cold_start(struct k_work *work);
/* ============================================================================================== */
/*                                        PRIVATE VARIABLES                                       */

static struct k_work_delayable gnss_work;

K_MSGQ_DEFINE(pvt_data_q, sizeof(struct nrf_modem_gnss_pvt_data_frame), 5, 4);

LOG_MODULE_REGISTER(gnss, LOG_LEVEL_DBG);
/* ============================================================================================== */
/*                                        PUBLIC FUNCTIONS                                        */

static void print_gnss_data(const struct nrf_modem_gnss_pvt_data_frame *pvt)
{
    LOG_INF("Latitude:  %.6f", pvt->latitude);
    LOG_INF("Longitude: %.6f", pvt->longitude);
    LOG_INF("Accuracy:  %d meters", pvt->accuracy);
}

static void gnss_event_handler(int event)
{
    struct nrf_modem_gnss_pvt_data_frame pvt_data;
    int err;
    switch (event)
    {
        case NRF_MODEM_GNSS_EVT_FIX:
            LOG_INF("GNSS fix acquired!");
            if (nrf_modem_gnss_read(&pvt_data, sizeof(pvt_data), NRF_MODEM_GNSS_DATA_PVT) == 0)
            {
                k_msgq_put(&pvt_data_q, &pvt_data, K_NO_WAIT);
            }
            k_work_cancel_delayable(&gnss_work);
            break;
    }
}
void rtc_cb_triggered(void)
{
    LOG_INF("RTC ALARM TRIGGERED: %d", rtc_get_epoch());
    app_uart_write("Wakeup!\n", sizeof("Wakeup!\n"));
}
void main(void)
{
    int err;
    struct nrf_modem_gnss_pvt_data_frame pvt_data;



    LOG_INF("Initializing GNSS Example in Zephyr");
    err = nrf_modem_lib_init();
    if (err)
    {
        LOG_ERR("Modem library initialization failed, error: %d", err);
        return err;
    }

    if (lte_lc_func_mode_set(LTE_LC_FUNC_MODE_ACTIVATE_GNSS) != 0)
    {
        LOG_ERR("Failed to activate GNSS functional mode");
        return -1;
    }

    // Set GNSS use case
    nrf_modem_gnss_use_case_set(NRF_MODEM_GNSS_USE_CASE_MULTIPLE_HOT_START);
    nrf_modem_gnss_event_handler_set(gnss_event_handler);
    uint16_t nmea_mask = NRF_MODEM_GNSS_NMEA_RMC_MASK |
                 NRF_MODEM_GNSS_NMEA_GGA_MASK |
                 NRF_MODEM_GNSS_NMEA_GLL_MASK |
                 NRF_MODEM_GNSS_NMEA_GSA_MASK |
                 NRF_MODEM_GNSS_NMEA_GSV_MASK;

    if (nrf_modem_gnss_nmea_mask_set(nmea_mask) != 0) {
        LOG_ERR("Failed to set GNSS NMEA mask");
        return -1;
    }
    /* Make QZSS satellites visible in the NMEA output. */
    if (nrf_modem_gnss_qzss_nmea_mode_set(NRF_MODEM_GNSS_QZSS_NMEA_MODE_CUSTOM) != 0) {
        LOG_WRN("Failed to enable custom QZSS NMEA mode");
    }

    if (nrf_modem_gnss_power_mode_set(NRF_MODEM_GNSS_PSM_DISABLED) != 0) {
        LOG_ERR("Failed to set GNSS power saving mode");
    }

    if (nrf_modem_gnss_start() != 0) {
        LOG_ERR("Failed to start GNSS");
        return -1;
    }
    // Schedule tasks for GNSS acquisition
    k_work_init_delayable(&gnss_work, gnss_cold_start);

    // Start Cold Start GNSS
    k_work_schedule(&gnss_work, K_NO_WAIT);

    rtc_init();
    rtc_alarm_cb_register(rtc_cb_triggered);
    rtc_set_alarm_for(7);

    while(1)
    {
        if (0 == k_msgq_get(&pvt_data_q, &pvt_data, K_FOREVER));

        print_gnss_data(&pvt_data);
    }
}

/* ============================================================================================== */
/*                                         PRIVATE FUNCTIONS                                      */

static void gnss_cold_start(struct k_work *work)
{
    LOG_INF("Starting GNSS cold start...");
    nrf_modem_gnss_fix_retry_set(120);
    nrf_modem_gnss_fix_interval_set(0);
    nrf_modem_gnss_start();
    k_work_schedule(&gnss_work, GNSS_TIMEOUT);
}
```

## src/rtc_api.c
```c
/* ============================================================================================== */
/*                                            INCLUDES                                            */
#include <zephyr/kernel.h>
#include <zephyr/logging/log.h>
#include <nrfx_rtc.h>
#include <hal/nrf_rtc.h>


/* ============================================================================================== */

/* ============================================================================================== */
/*                                        DEFINES/TYPEDEFS                                        */
#define RTC_SECONDS(s)                      (s * 8)
#define RTC_ALARM_COMPARE                   (NRFX_RTC_INT_COMPARE0)
#define RTC_EPOCH_SECONDS_COMPARE           (NRFX_RTC_INT_COMPARE1)


/* ============================================================================================== */
/*                                   PRIVATE FUNCTION DEFINITIONS                                 */
static void rtc_handler(nrfx_rtc_int_type_t int_type);

/* ============================================================================================== */
/*                                        PRIVATE VARIABLES                                       */

static const nrfx_rtc_t rtc = NRFX_RTC_INSTANCE(0);
static uint32_t epoch_time = 0U;

LOG_MODULE_REGISTER(RTC, LOG_LEVEL_DBG);
/* ============================================================================================== */
/*                                        PUBLIC FUNCTIONS                                        */

int rtc_init(void)
{
    nrfx_rtc_config_t config = NRFX_RTC_DEFAULT_CONFIG;
    config.prescaler = 4095; // 125ms per tick

    nrfx_rtc_init(&rtc, &config, rtc_handler);

    /* Rejestracja przerwań RTC2 */
    IRQ_CONNECT(NRFX_IRQ_NUMBER_GET(NRF_RTC0), 1, nrfx_isr, nrfx_rtc_0_irq_handler, 0);
    irq_enable(NRFX_IRQ_NUMBER_GET(NRF_RTC0));

    nrfx_rtc_tick_enable(&rtc, true);
    nrfx_rtc_enable(&rtc);

    nrfx_rtc_cc_set(&rtc, RTC_EPOCH_SECONDS_COMPARE, nrfx_rtc_counter_get(&rtc) + RTC_SECONDS(1), true);

    LOG_INF("RTC initialized and started.");
}

int rtc_set_alarm_for(int seconds)
{
    return nrfx_rtc_cc_set(&rtc, RTC_ALARM_COMPARE, nrfx_rtc_counter_get(&rtc) + RTC_SECONDS(seconds), true);
}

int epoch_update(uint32_t new_epoch)
{
    epoch_time = new_epoch;
    return 0;
}


/* ============================================================================================== */
/*                                         PRIVATE FUNCTIONS                                      */
static void rtc_handler(nrfx_rtc_int_type_t int_type)
{
    switch (int_type)
    {
    case RTC_ALARM_COMPARE:
        LOG_DBG("RTC Alarm event triggered!");
        break;
    case RTC_EPOCH_SECONDS_COMPARE:
        epoch_time++;
        nrfx_rtc_cc_set(&rtc, RTC_EPOCH_SECONDS_COMPARE, nrfx_rtc_counter_get(&rtc) + RTC_SECONDS(1), true);
    default:
        break;
    }
}
```

## src/rtc_api.h
```c
/* ============================================================================================== */
/*                                            INCLUDES                                            */
#include <zephyr/kernel.h>

/* ============================================================================================== */

/* ============================================================================================== */
/*                                        DEFINES/TYPEDEFS                                        */

/* ============================================================================================== */
/*                                        PUBLIC FUNCTIONS                                        */

int rtc_init(void);
int rtc_set_alarm_for(int seconds);
int epoch_update(uint32_t new_epoch);
/* ============================================================================================== */
/*                                         PRIVATE FUNCTIONS                                      */
```
